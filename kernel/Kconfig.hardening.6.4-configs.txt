## kernel/Kconfig.hardening.6.4-configs.txt
```kconfig
config CC_HAS_AUTO_VAR_INIT_PATTERN
config CC_HAS_AUTO_VAR_INIT_ZERO
config CC_HAS_AUTO_VAR_INIT_ZERO_BARE
config CC_HAS_AUTO_VAR_INIT_ZERO_ENABLER
config INIT_ON_ALLOC_DEFAULT_ON
config INIT_ON_FREE_DEFAULT_ON
config INIT_STACK_ALL_PATTERN
config INIT_STACK_ALL_ZERO
config INIT_STACK_NONE
config CC_HAS_ZERO_CALL_USED_REGS
config ZERO_CALL_USED_REGS
config CC_HAS_RANDSTRUCT
config GCC_PLUGIN_RANDSTRUCT
config RANDSTRUCT
config RANDSTRUCT_FULL
config RANDSTRUCT_NONE
config RANDSTRUCT_PERFORMANCE
config GCC_PLUGIN_STACKLEAK
config GCC_PLUGIN_STACKLEAK_VERBOSE
config STACKLEAK_METRICS
config STACKLEAK_RUNTIME_DISABLE
config STACKLEAK_TRACK_MIN_SIZE
config GCC_PLUGIN_STRUCTLEAK
config GCC_PLUGIN_STRUCTLEAK_BYREF
config GCC_PLUGIN_STRUCTLEAK_BYREF_ALL
config GCC_PLUGIN_STRUCTLEAK_USER
config GCC_PLUGIN_STRUCTLEAK_VERBOSE
```
